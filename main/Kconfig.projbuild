## main/Kconfig.projbuild
```kconfig
menu "Example configuration"
    choice EXAMPLE_CHIP_TYPE
        prompt "Select chip type"
        default EXAMPLE_CHIP_TYPE_SI70xx
        help
            Select chip type.

        config EXAMPLE_CHIP_TYPE_SI70xx
            bool "SI70xx"
            help
                Choose this when the chip is one of SI70xx family.
        config EXAMPLE_CHIP_TYPE_SHT2x_HTU21D
            bool "SHT2x or HTU21D"
            help
                Choose this when the chip is either SHT2x or HTU21D.
    endchoice

    rsource "../Kconfig.i2c"
endmenu

menu "WiFi Configuration"

    config WIFI_SSID
        string "WiFi SSID"
        default ""
        help
            SSID du réseau WiFi

    config WIFI_PASSWORD
        string "WiFi Password"
        default ""
        help
            Mot de passe du réseau WiFi

endmenu

menu "MQTT Configuration"

    config MQTT_BROKER_URI
        string "MQTT broker URI"
        default "mqtt://192.168.1.126"
        help
            Adresse du broker MQTT (ex: mqtt://192.168.1.126)

    config MQTT_BROKER_PORT
        int "MQTT broker port"
        default 1883
        help
            Port du broker MQTT (ex: 1883)

    config MQTT_PUB_TOPIC
        string "MQTT publish topic"
        default "esp32c6/si7021"
        help
            Topic sur lequel publier les mesures

    config MQTT_QOS
        int "MQTT QoS level"
        range 0 2
        default 0
        help
            Niveau QoS pour les publications (0, 1 ou 2)

    config MQTT_USERNAME
        string "MQTT username"
        default ""
        help
            Nom d'utilisateur MQTT (laisser vide si non utilisé)

    config MQTT_PASSWORD
        string "MQTT password"
        default ""
        help
            Mot de passe MQTT (laisser vide si non utilisé)

endmenu

menu "Configuration du noeud météo"

    config TEMP_DELTA
        int "Seuil de variation de température (dixièmes de °C)"
        default 5
        help
            Seuil de variation de température exprimé en dixièmes de degré Celsius.

    config HUM_DELTA
        int "Seuil de variation d'humidité (dixièmes de %)"
        default 10
        help
            Seuil de variation d'humidité relative exprimé en dixièmes de pourcentage.

    config PERIODIC_DELAY_MINUTES
        int "Intervalle de publication périodique (minutes)"
        default 12
        help
            Intervalle de publication périodique en minutes.

    config MIN_PUBLISH_INTERVAL_SECONDS
        int "Intervalle minimal entre deux publications (secondes)"
        default 5
        help
            Durée minimale en secondes entre deux publications MQTT.

endmenu
```
